# file: RM47mm_LED_64MHz.ioc
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Dma.Request0=TIM4_CH2
Dma.TIM4_CH2.0.Direction=DMA_MEMORY_TO_PERIPH
Dma.TIM4_CH2.0.Instance=DMA1_Channel4
Dma.TIM4_CH2.0.MemDataAlignment=DMA_MDATAALIGN_HALFWORD
Dma.TIM4_CH2.0.MemInc=DMA_MINC_ENABLE
Dma.TIM4_CH2.0.Mode=DMA_NORMAL
Dma.TIM4_CH2.0.PeriphDataAlignment=DMA_PDATAALIGN_HALFWORD
Dma.TIM4_CH2.0.PeriphInc=DMA_PINC_DISABLE
Dma.TIM4_CH2.0.Priority=DMA_PRIORITY_LOW
Mcu.Family=STM32F1
Mcu.Name=STM32F103C(8-B)Tx
Mcu.Package=LQFP48
NVIC.DMA1_Channel4_IRQn=true\:0\:0\:false\:false\:true\:false\:true\:true
NVIC.PriorityGroup=NVIC_PRIORITYGROUP_4
PA13.Mode=Serial_Wire
PA13.Signal=SYS_JTMS-SWDIO
PA14.Mode=Serial_Wire
PA14.Signal=SYS_JTCK-SWCLK
PB7.GPIO_Speed=GPIO_SPEED_FREQ_HIGH
PB7.Signal=S_TIM4_CH2
ProjectManager.HeapSize=0x200
ProjectManager.StackSize=0x400
ProjectManager.TargetToolchain=MDK-ARM V5.32
RCC.AHBFreq_Value=64000000
RCC.APB1CLKDivider=RCC_HCLK_DIV2
RCC.APB1Freq_Value=32000000
RCC.APB1TimFreq_Value=64000000
RCC.APB2Freq_Value=64000000
RCC.APB2TimFreq_Value=64000000
RCC.HCLKFreq_Value=64000000
RCC.PLLMUL=RCC_PLL_MUL16
RCC.SYSCLKFreq_VALUE=64000000
RCC.SYSCLKSource=RCC_SYSCLKSOURCE_PLLCLK
RCC.USBFreq_Value=64000000
SH.S_TIM4_CH2.0=TIM4_CH2,PWM Generation2 CH2
TIM4.Channel-PWM\ Generation2\ CH2=TIM_CHANNEL_2
TIM4.Period=79
board=custom

// file: Core/Src/main.c
/* USER CODE BEGIN Header */
/**
  ******************************************************************************
  * @file           : main.c
  * @brief          : Main program body
  ******************************************************************************
  * @attention
  *
  * Copyright (c) 2023 STMicroelectronics.
  * All rights reserved.
  *
  * This software is licensed under terms that can be found in the LICENSE file
  * in the root directory of this software component.
  * If no LICENSE file comes with this software, it is provided AS-IS.
  *
  ******************************************************************************
  */
/* USER CODE END Header */
#include "main.h"
#include "dma.h"
#include "tim.h"
#include "gpio.h"
#include "ws2812.h"

void SystemClock_Config(void);

int main(void)
{

  /* MCU Configuration--------------------------------------------------------*/

  /* Reset of all peripherals, Initializes the Flash interface and the Systick. */
  HAL_Init();

  /* Configure the system clock */
  SystemClock_Config();

  /* Initialize all configured peripherals */
  MX_GPIO_Init();
  MX_DMA_Init();
  MX_TIM4_Init();
  /* USER CODE BEGIN 2 */
led_init();
int direction = 6;
int LED_state = 0;

uint8_t g_value_r[LED_NUM] = {0x00};
uint8_t g_value_b[LED_NUM] = {0x00};
uint8_t g_value_g[LED_NUM] = {0x00};

for (uint8_t i = 0 ; i < LED_NUM; i++)
{
    led_set(i, g_value_r[i], g_value_g[i], g_value_b[i]);
}
uint8_t g_value_delta = 0x08;
g_value_r[LED_state] = 0xFF;
g_value_g[LED_state] = 0xFF;
g_value_b[LED_state] = 0xFF;
  /* USER CODE END 2 */

	g_value_b[0] =  0x00;
	g_value_r[0] =  0x00;
	g_value_g[0] =  0x00;

  /* Infinite loop */
  while (1)
  {

	HAL_Delay(10);

	if (g_value_r[0]==0x00&&g_value_g[0]==0x00&&g_value_b[0]==0x00)
	{
		LED_state = 0;
	}
	else if(g_value_r[0]==0xFF&&g_value_g[0]==0x00&&g_value_b[0]==0x00)
	{
		LED_state = 1;
	}
	else if(g_value_r[0]==0x00&&g_value_g[0]==0xFF&&g_value_b[0]==0x00)
	{
		LED_state = 2;
	}
	else if(g_value_r[0]==0x00&&g_value_g[0]==0x00&&g_value_b[0]==0xFF)
	{
		LED_state = 3;
	}

	if(LED_state == 0)
	{
		g_value_r[0] = g_value_r[0] + 0x01;
	}
	else if(LED_state == 1)
	{
		g_value_r[0] = g_value_r[0] - 0x01;
		g_value_g[0] = g_value_g[0] + 0x01;
	}
	else if(LED_state == 2)
	{
		g_value_g[0] = g_value_g[0] - 0x01;
		g_value_b[0] = g_value_b[0] + 0x01;
	}
	else if(LED_state == 3)
	{

		g_value_b[0] = g_value_b[0] - 0x01;
	}

	for (uint8_t i = 0 ; i < LED_NUM; i++)
{
     led_set(i, g_value_r[0], g_value_g[0], g_value_b[0]);
}
	led_on();

//if (((g_value_r[0] >=  0xFF - g_value_delta) || (g_value_b[0] <= g_value_delta/2) )&& g_value_g[0] == 0x00 && direction == 6)
//{
//    direction = 1;
//    g_value_r[0] = 0x00;
//    g_value_g[0] = 0xFF;
//    g_value_b[0] = 0x00;
//}
//else if (g_value_r[0] == 0xFF && g_value_g[0] >= 0xFF - g_value_delta && g_value_b[0] == 0x00 && direction == 1)
//{
//    g_value_g[0] = 0xFF;
//    direction = 2;
//}
//else if (g_value_r[0] <= g_value_delta && g_value_g[0] == 0xff && g_value_b[0] == 0x00 && direction == 2)
//{
//    g_value_r[0] = 0x00;
//    direction = 3;
//}
//else if (g_value_r[0] ==  0x00 && g_value_g[0] == 0xff && g_value_b[0] >= (0xFF - g_value_delta) && direction == 3)
//{
//    g_value_b[0] = 0x00;
//    direction = 4;
//}
//else if (g_value_r[0] ==  0x00 && g_value_g[0] <= g_value_delta && g_value_b[0] == 0xff && direction == 4)
//{
//    g_value_g[0] = 0xFF;
//    direction = 5;
//}
//else if (g_value_r[0] >=  (0x8B - g_value_delta) && g_value_g[0] == 0x00 && g_value_b[0] == 0xff && direction == 5)
//{
//    direction = 6;
//    g_value_r[0] = 0x8B;
//    g_value_g[0] = 0x00;
//    g_value_b[0] = 0xFF;
//}

//if (direction == 1)
//{
//    g_value_g[0] = g_value_g[0] + g_value_delta;
//}
//else if (direction == 2)
//{
//    g_value_r[0] = g_value_r[0] - g_value_delta;
//}
//else if (direction == 3)
//{
//    g_value_b[0] = g_value_b[0] + g_value_delta;
//}
//else if (direction == 4)
//{
//    g_value_g[0] = g_value_g[0] - g_value_delta;
//}
//else if (direction == 5)
//{
//    g_value_r[0] = g_value_r[0] + g_value_delta;
//}
//else if (direction == 6)
//{
//    g_value_r[0] = g_value_r[0] + g_value_delta/2;
//    g_value_b[0] = g_value_b[0] - g_value_delta;

//}

//for (int i = 8 ; i >0; i-- )
//{
//    g_value_r[i] = g_value_r[i-1];
//    g_value_g[i] = g_value_g[i-1];
//    g_value_b[i] = g_value_b[i-1];
//}

  }
}

void SystemClock_Config(void)
{
  RCC_OscInitTypeDef RCC_OscInitStruct = {0};
  RCC_ClkInitTypeDef RCC_ClkInitStruct = {0};

  /** Initializes the RCC Oscillators according to the specified parameters
  * in the RCC_OscInitTypeDef structure.
  */
  RCC_OscInitStruct.OscillatorType = RCC_OSCILLATORTYPE_HSI;
  RCC_OscInitStruct.HSIState = RCC_HSI_ON;
  RCC_OscInitStruct.HSICalibrationValue = RCC_HSICALIBRATION_DEFAULT;
  RCC_OscInitStruct.PLL.PLLState = RCC_PLL_ON;
  RCC_OscInitStruct.PLL.PLLSource = RCC_PLLSOURCE_HSI_DIV2;
  RCC_OscInitStruct.PLL.PLLMUL = RCC_PLL_MUL16;
  if (HAL_RCC_OscConfig(&RCC_OscInitStruct) != HAL_OK)
  {
    Error_Handler();
  }

  /** Initializes the CPU, AHB and APB buses clocks
  */
  RCC_ClkInitStruct.ClockType = RCC_CLOCKTYPE_HCLK|RCC_CLOCKTYPE_SYSCLK
                              |RCC_CLOCKTYPE_PCLK1|RCC_CLOCKTYPE_PCLK2;
  RCC_ClkInitStruct.SYSCLKSource = RCC_SYSCLKSOURCE_PLLCLK;
  RCC_ClkInitStruct.AHBCLKDivider = RCC_SYSCLK_DIV1;
  RCC_ClkInitStruct.APB1CLKDivider = RCC_HCLK_DIV2;
  RCC_ClkInitStruct.APB2CLKDivider = RCC_HCLK_DIV1;

  if (HAL_RCC_ClockConfig(&RCC_ClkInitStruct, FLASH_LATENCY_2) != HAL_OK)
  {
    Error_Handler();
  }
}

void Error_Handler(void)
{
  __disable_irq();
  while (1)
  {
  }
}
